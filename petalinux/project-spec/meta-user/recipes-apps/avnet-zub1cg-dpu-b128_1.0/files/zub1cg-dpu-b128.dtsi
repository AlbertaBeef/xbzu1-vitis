// SPDX-License-Identifier: GPL-2.0
/*
 * dts file for Avnet ZUBoard DPU B128 design
 *
 * (C) Copyright 2022, Avnet, Inc.
 *
 */

/dts-v1/;
/plugin/;
/{ 
	fragment@0 {
		target = <&fpga_full>;
		overlay0: __overlay__ {
			#address-cells = <2>;
			#size-cells = <2>;
			firmware-name = "zub1cg-dpu-b128.bit.bin";
			resets = <&zynqmp_reset 116>, <&zynqmp_reset 117>, <&zynqmp_reset 118>, <&zynqmp_reset 119>;
		};
	};
	fragment@1 {
		target = <&amba>;
		overlay1: __overlay__ {
			afi0: afi0 {
				compatible = "xlnx,afi-fpga";
				config-afi = <0 0>, <1 0>, <2 0>, <3 0>, <4 0>, <5 0>, <6 0>, <7 0>, <8 0>, <9 0>, <10 0>, <11 0>, <12 0>, <13 0>, <14 0xa00>, <15 0x000>;
				resets = <&zynqmp_reset 116>,
						<&zynqmp_reset 117>,
						<&zynqmp_reset 118>,
						<&zynqmp_reset 119>;
				reset-names = "pl0", "pl1", "pl2", "pl3";
			};		
			zocl: zyxclmm_drm {
				compatible = "xlnx,zocl";
				status = "okay";
				interrupt-parent = <&gic>;
				interrupts = <0 89  4>, <0 90  4>, <0 91  4>, <0 92  4>,
					     <0 93  4>, <0 94  4>, <0 95  4>, <0 96  4>;
			};
		};
	};
};
