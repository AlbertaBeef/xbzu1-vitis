// SPDX-License-Identifier: GPL-2.0
/*
 * dts file for Avnet ZUBoard VVAS smart_model_select
 *
 * (C) Copyright 2022, Avnet, Inc.
 *
 */

/dts-v1/;
/plugin/;

&fpga_full {
	#address-cells = <2>;
	#size-cells = <2>;
	firmware-name = "zub1cg-vvas-sms.bit.bin";
	resets = <&zynqmp_reset 116>, <&zynqmp_reset 117>, <&zynqmp_reset 118>, <&zynqmp_reset 119>;
};


